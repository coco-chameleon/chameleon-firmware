## CMakeLists.txt
```
# SPDX-FileCopyrightText: 2024 Sam Hanes <sam@maltera.com>
# SPDX-License-Identifier: GPL-3.0-or-later

cmake_minimum_required(VERSION 3.16)

include($ENV{IDF_PATH}/tools/cmake/project.cmake)

project(coco-chameleon)
```

## sysbuild.conf
```
# SPDX-FileCopyrightText: 2024 Sam Hanes <sam@maltera.com>
# SPDX-License-Identifier: GPL-3.0-or-later

SB_CONFIG_BOOTLOADER_MCUBOOT=y
```

## west.yml
```
# SPDX-FileCopyrightText: 2024 Sam Hanes <sam@maltera.com>
# SPDX-License-Identifier: GPL-3.0-or-later

manifest:
  remotes:
    - name: zephyr
      url-base: https://github.com/zephyrproject-rtos

  projects:
    - name: zephyr
      remote: zephyr
      revision: main
      import:
        name-allowlist:
          - hal_espressif
          - hal_xtensa
          - mcuboot
```

## prj.conf
```kconfig
# SPDX-FileCopyrightText: 2024 Sam Hanes <sam@maltera.com>
# SPDX-License-Identifier: GPL-3.0-or-later

CONFIG_ESPTOOLPY_FLASH_MODE_AUTO_DETECT=n
CONFIG_ESPTOOLPY_FLASHMODE_QIO=y
CONFIG_ESPTOOLPY_FLASHFREQ_80M=y
CONFIG_ESPTOOLPY_FLASHSIZE_8MB=y

CONFIG_BOOTLOADER_MCUBOOT=y
CONFIG_MCUBOOT_GENERATE_UNSIGNED_IMAGE=y
CONFIG_MCUBOOT_GENERATE_CONFIRMED_IMAGE=n
CONFIG_MCUBOOT_BOOTLOADER_MODE_SWAP_WITHOUT_SCRATCH=y

CONFIG_LOG=y
CONFIG_LOG_MODE_DEFERRED=y

CONFIG_LEGACY_GENERATED_INCLUDE_PATH=n
```

## src/main.c
```c
// SPDX-FileCopyrightText: 2024 Sam Hanes <sam@maltera.com>
// SPDX-License-Identifier: GPL-3.0-or-later

#include <zephyr/logging/log.h>

LOG_MODULE_REGISTER(chameleon);

int main(void)
{
    LOG_INF("Hello %s\n", CONFIG_BOARD_TARGET);
    return 0;
}
```
